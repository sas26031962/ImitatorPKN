/*
 Класс описания состояния СУО. 
 Переключение между состояниями по последовательному порту
 Дребезг в этом случае осутствует 
 */
#ifndef C_SUO
#define C_SUO
 //========================================================================
 //---------------------------- ПОДКЛЮЧАЕМЫЕ ФАЙЛЫ ------------------------
 //========================================================================

 //========================================================================
 //-------------------------------- КОНСТАНТЫ -----------------------------
 //========================================================================
 #define UP_DWELL 20000
 #define DOWN_DWELL 10000
 
 //========================================================================
 //--------------------------- ОБЪЯВЛЕНИЕ КЛАССОВ -------------------------
 //========================================================================
 
class cSUO{
 
 //------------------------------------------------------------------------
 // Атрибуты
 //------------------------------------------------------------------------
 
  
 bool IsOn;		    		// СУО включено
 bool IsUp;					// СУО в процессе включения
 bool IsDown;            	// СУО в процессе выключения
 bool IsOff;				// СУО выключено

 long PreviousTime;			// Значение предыдущего маркера времени
 
 public:
 
 static bool IsSwitchOn;	// Команда включения принята
 static bool IsSwitchOff;	// Команда выключения принята

 //------------------------------------------------------------------------
 // Методы
 //------------------------------------------------------------------------

 protected: 
 
 public:
 
 bool Current;           	// Текущее состояние СУО

 void operate();  			  // Реализация функциональности джойстика

 char getState();			    // Чтение текущего состояния пульта
 
 //------------------------------------------------------------------------
 // Конструкторы
 //------------------------------------------------------------------------
 cSUO();
 
};//End of class cSUO

 //========================================================================
 //--------------------------- РЕАЛИЗАЦИЯ МЕТОДОВ -------------------------
 //========================================================================

//
// Конструктор
//
cSUO::cSUO(
    )
{
  this->IsOff = false;
  this->IsOn = false;
  this->IsUp = false;
  this->IsDown = false;
} 

//
// Реализация функциональности
//
void cSUO::operate()
{
  // Обработка команды включения СУО
  if(cSUO::IsSwitchOn)
  {
    this->PreviousTime = cKeyX::CurrentTime; 

    cSUO::IsSwitchOn = false;
    
    this->IsOff = false;
    this->IsOn = false;
    this->IsUp = true;
    this->IsDown = false;
    
    this->PreviousTime = cKeyX::CurrentTime;

    Serial.println("SUO had switched on and is mounted");
  }
  
  // Обработка команды выключения СУО
  if(cSUO::IsSwitchOff)
  {
    this->PreviousTime = cKeyX::CurrentTime; 

    cSUO::IsSwitchOff = false;
    this->IsOff = false;
    this->IsOn = false;
    this->IsUp = false;
    this->IsDown = true;
    
    this->PreviousTime = cKeyX::CurrentTime;

    Serial.println("SUO had switched off and is unmounted");
  }
  
  // Обработка процесса выключения СУО
  if(this->IsDown && (cKeyX::CurrentTime - this->PreviousTime > DOWN_DWELL))
  {
    this->IsOff = true;
    this->IsOn = false;
    this->IsUp = false;
    this->IsDown = false;

    Serial.println("SUO had unmounted");
  }
  
  // Обработка процесса включения СУО
  if(this->IsUp && (cKeyX::CurrentTime - this->PreviousTime > UP_DWELL))
  {
    this->IsOff = false;
    this->IsOn = true;
    this->IsUp = false;
    this->IsDown = false;

    Serial.println("SUO had mounted");
  }
  
}//End of void cSUO::operate()


//
// Чтение текущего состояния
//

 char cSUO::getState()
 {
	if(this->IsOff)	return 0;		// СУО выключено
	if(this->IsOn) return 1;		// СУО включено
	if(this->IsUp) return 2;		// СУО в процессе включения
	if(this->IsDown) return 3; 		// СУО в процессе выключения
 }

//--------------------------------------------------------------------------------
//----------------------------------ОБЪЯВЛЕНИЕ СТАТИЧЕСКИХ ПЕРЕМЕННЫХ-------------
//--------------------------------------------------------------------------------
 bool cSUO::IsSwitchOn = false;		// Команда включения принята
 bool cSUO::IsSwitchOff = false;	// Команда выключения принята


//--------------------------------------------------------------------------------
#endif
